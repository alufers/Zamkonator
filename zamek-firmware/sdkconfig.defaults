## zamek-firmware/sdkconfig.defaults
```kconfig
CONFIG_PARTITION_TABLE_CUSTOM=y
CONFIG_PARTITION_TABLE_CUSTOM_FILENAME="partitions.csv"

#
# Serial flasher config
#

# BOOTLOADER
CONFIG_BOOTLOADER_LOG_LEVEL_WARN=y
```
